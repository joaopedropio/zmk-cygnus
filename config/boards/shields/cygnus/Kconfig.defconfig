## config/boards/shields/cygnus/Kconfig.defconfig
```kconfig
if SHIELD_CYGNUS_DONGLE

config ZMK_KEYBOARD_NAME
    default "CYGNUS"

config ZMK_SPLIT_ROLE_CENTRAL
    default y

config ZMK_SPLIT
    default y

endif

if SHIELD_CYGNUS_DONGLE || SHIELD_CYGNUS_LEFT || SHIELD_CYGNUS_RIGHT

config ZMK_SPLIT
    default y

endif
```

## config/west.yml
```yaml
manifest:
  remotes:
    - name: zmkfirmware
      url-base: https://github.com/zmkfirmware
    - name: joaopedropio
      url-base: https://github.com/joaopedropio
  projects:
    - name: zmk
      remote: zmkfirmware
      revision: main
      # revision: v0.2
      import: app/west.yml
    - name: zmk-pacman-module
      remote: joaopedropio
      revision: space-shooter
      # - name: snake-module
      #   remote: joaopedropio
      #   revision: master
  self:
    path: config
```
